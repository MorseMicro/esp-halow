## halow/Kconfig
```kconfig
# Copyright 2025-2026 Morse Micro
# SPDX-License-Identifier: Apache-2.0

rsource "components/firmware/Kconfig"
rsource "components/mmpktmem/Kconfig"
rsource "components/shims/Kconfig"
rsource "components/regdb/Kconfig"

menu "Wi-Fi HaLow Connection Manager"

    config WIFI_HALOW
        bool "Enable Morse Micro Wi-Fi HaLow support"
        default y
        select MBEDTLS_NIST_KW_C

    config HALOW_COUNTRY_CODE
        string "Country code to use for Wi-Fi HaLow"
        default "??"

	config HALOW_PS_MODE
		bool "Enable Morse Micro HaLow Powersave Mode"
		default y
		depends on MM_WAKE >= 0
		depends on MM_BUSY >= 0
		help
			This can only be set to true for devices which have the BUSY and WAKE
			pins connected.

    config HALOW_COMPRESS_FIRMWARE
        bool "Compresses firmware at the cost of the HaLow chip taking longer to boot"
        default y
        help
            This saves a large chunk of flash at the cost of extra startup time
            decompressing the firmware on boot

    config HALOW_AP_MODE
        bool "Enable HaLow AP-mode support"
        default n
        help
            Adds requisite components for AP-mode viathe HaLow interface. This
            is disabled by default due to the extra functionality increasing the
            flash and ram requirements by a non inconsequential amount.

endmenu
```

## halow/examples/ap_mode/main/Kconfig.projbuild
```kconfig
# Copyright 2026 Morse Micro
#
# SPDX-License-Identifier: Apache-2.0

menu "HaLow ap_mode Example Configuration"

config WIFI_SSID
	string "Wi-Fi SSID"
	default "MorseMicroESP32AP"

config WIFI_PSK
	string "Wi-Fi Password"
	default "12345678"

config S1G_CHANNEL
    int "S1G Channel"

config S1G_OPCLASS
    int "S1G Op-Class"

endmenu
```

## halow/examples/porting_assistant/sdkconfig.defaults
```kconfig
# Copyright 2026 Morse Micro
#
# SPDX-License-Identifier: Apache-2.0

CONFIG_FREERTOS_HZ=1000

CONFIG_HALOW_COMPRESS_FIRMWARE=n
```
